// Copyright 2014
// Dave Marquart (dmarquart@gmail.com)
//
//
// This program is free software; you can redistribute it and/or modify
// it under the terms of the GNU General Public License as published by
// the Free Software Foundation; either version 2 of the License, or
// (at your option) any later version.
//
// This program is distributed in the hope that it will be useful,
// but WITHOUT ANY WARRANTY; without even the implied warranty of
// MERCHANTABILITY or FITNESS FOR A PARTICULAR PURPOSE.  See the
// GNU General Public License for more details.
//
// You should have received a copy of the GNU General Public License
// along with this program; if not, write to the Free Software
// Foundation, Inc., 59 Temple Place, Suite 330, Boston, MA 02111-1307 USA

/dts-v1/;
/plugin/;

/ {
	compatible = "ti,beaglebone-black";

	/* identification */
	part-number = "BB-STEPONECNC";
	version = "00A0";

	/* state the resources this cape uses */
	exclusive-use =
		/* the pin header uses */
		"P8.7",		/* E-Stop	*/
		"P8.8",		/* CycleStart	*/
		"P8.9",		/* SpindleOut	*/
		"P8.10",	/* PWS_ON	*/
		"P9.23",	/* X_Home	*/
		"P9.24",	/* Z_Dir	*/
		"P9.25",	/* Y_Home	*/
		"P9.26",	/* Z_Step	*/
		"P9.27",	/* Z_Home	*/
		"P9.28",	/* Y_Dir	*/
		"P9.29",	/* X_Dir	*/
		"P9.30",	/* Y_Step	*/
		"P9.31",	/* X_Step	*/

	/* the hardware IP uses */
		"gpio1_17",
		"gpio0_15",
		"gpio3_21",
		"gpio0_14",
		"gpio3_19",
		"gpio3_17",
		"gpio3_15",
		"gpio3_16",
		"gpio3_14",
		"gpio2_2",
		"gpio2_3",
		"gpio2_5",
		"gpio2_4",
		"pru0";
	
	fragment@0 {
		target = <&am33xx_pinmux>;
		__overlay__ {

			step_pins: step_pins {
				pinctrl-single,pins = <
					0x090 0x3f	/* P8.7		gpio2.2		E-Stop	*/
					0x094 0x3f	/* P8.8		gpio2.3		CycleStart	*/
					0x09c 0x3f	/* P8.9		gpio2.5		SpindleOut	*/
					0x098 0x3f	/* P8.10	gpio2.4		PWS_ON	*/
					0x1ac 0x3f	/* p9.25	gpio0.3		Y_Home	*/
					0x044 0x3f	/* P9.23	gpio1.17	X_Home	*/
					0x184 0x3f	/* P9.24	gpio0.15	Z_Dir	*/
					0x180 0x3f	/* P9.26	gpio0.14	Z_Step	*/
					0x1a4 0x3f	/* P9.27	gpio3.19	Z_Home	*/
					0x19c 0x3f	/* P9.28	gpio3.17	Y_Dir	*/
					0x194 0x3f	/* P9.29	gpio3.15	X_Dir	*/
					0x198 0x3f	/* P9.30	gpio3.16	Y_Step	*/
					0x190 0x3f	/* P9.31	gpio3.14	X_Step	*/
				>;
			};
		};
	};


    /************************/
    /* PRUSS */
    /************************/

    fragment@1 {
        target = <&pruss>;
        __overlay__ {
            status = "okay";
			
			pinctrl-names = "default";
			pinctrl-0 = <&step_pins>;
        };
    };
};

